#include <zmk-helpers/key-labels/36.h>

#define K_HAS_POINTER
#define K_NONE_RH2

#define K_MAPPING( \
    LT4, LT3, LT2, LT1, LT0,    RT0, RT1, RT2, RT3, RT4, \
    LM4, LM3, LM2, LM1, LM0,    RM0, RM1, RM2, RM3, RM4, \
    LB4, LB3, LB2, LB1, LB0,    RB0, RB1, RB2, RB3, RB4, \
              LH2, LH1, LH0,    RH0, RH1, RH2 \
) \
    LT4 LT3 LT2 LT1 LT0    RT0 RT1 RT2 RT3 RT4 \
    LM4 LM3 LM2 LM1 LM0    RM0 RM1 RM2 RM3 RM4 \
    LB4 LB3 LB2 LB1 LB0    RB0 RB1 RB2 RB3 RB4 \
            LH2 LH1 LH0    RH0 RH1

#include "shared/keymap_common.dtsi"
