/**
 * Default Layer - QWERTY
 */
ZMK_LAYER(def,
// ╭───────────────┬───────────────┬───────────────┬───────────────┬───────────────┬───────────────╮   ╭───────────────┬───────────────┬───────────────┬───────────────┬───────────────┬───────────────╮
// │               │           Q Й │           W Ц │           E У │           R К │           T Е │   │           Y Н │           U Г │           I Ш │           O З │           P Х │               │
    &lt MSE ESC     _ Q             _ W             _ E             _ R             _ T                 _ Y             _ U             _ I             _ O             _ P             _ BSPC
// ├───────────────├───────────────┼───────────────┼───────────────┼───────────────┼───────────────┤   ├───────────────├───────────────┼───────────────┼───────────────┼───────────────┼───────────────┤
// │               │           A Ф │           S Ы │           D В │           F А │           G П │   │           H Р │           J О │           K Л │           L Д │           ~ Ж │               │
    _ TAB           _ A             _ S             _ D             _ F             _ G                 _ H             _ J             _ K             _ L             _ UL_TILDE      _ DEL
// ├───────────────├───────────────┼───────────────┼───────────────┼───────────────┼───────────────┤   ├───────────────├───────────────┼───────────────┼───────────────┼───────────────┼───────────────┤
// │               │           Z Я │           X Ч │           C С │           V М │           B И │   │           N Т │           M Ь │           & Б │           [ Ю │           ] Э │             / │
    _ LCTRL         _ Z             _ X             _ C             _ V             _ B                 _ N             _ M             _ UL_AMPS       _ UL_LBKT       _ UL_RBKT       &lt FN UL_FSLH
// ╰───────────────┴───────────────┴───────────────┼───────────────┼───────────────┼───────────────┤   ├───────────────├───────────────┼───────────────┼───────────────┴───────────────┴───────────────╯
//                                                 │               │               │               │   │               │               │               │
                                                    _ LGUI          _ LSHFT         &lt NAV SPACE       &lt EXT ENTER   &mo SYM         _ RALT
//                                                 ╰───────────────┴───────────────┴───────────────╯   ╰───────────────┴───────────────┴───────────────╯
)

/**
 * SYM Layer
 */
ZMK_LAYER(sym,
// ╭───────────────┬───────────────┬───────────────┬───────────────┬───────────────┬───────────────╮   ╭───────────────┬───────────────┬───────────────┬───────────────┬───────────────┬───────────────╮
// │               │             @ │             # │             $ │             ( │             ) │   │             ! │             ? │             * │             % │             ^ │               │
    _ ESC           _ UL_AT         _ UL_HASH       _ UL_DLLR       _ UL_LPAR       _ UL_RPAR           _ UL_EXCL       _ UL_QSTM       _ UL_ASTRK      _ UL_PRCNT      _ UL_CARET      _ BSPC
// ├───────────────├───────────────┼───────────────┼───────────────┼───────────────┼───────────────┤   ├───────────────├───────────────┼───────────────┼───────────────┼───────────────┼───────────────┤
// │               │             ` │             ' │             " │             [ │             ] │   │             : │             . │             + │             = │            -> │               │
    _ TAB           _ UL_GRAVE      _ UL_SQT        _ UL_DQT        _ LA(UL_LBKT)   _ LA(UL_RBKT)       _ LS(UL_DOT)    _ UL_DOT        _ PLUS          _ EQUAL         _ LS(LA(K))     _ DEL
// ├───────────────├───────────────┼───────────────┼───────────────┼───────────────┼───────────────┤   ├───────────────├───────────────┼───────────────┼───────────────┼───────────────┼───────────────┤
// │               │             | │             \ │             / │             { │             } │   │             ; │             , │             - │             _ │           ~ Ж │               │
    _ LCTRL         _ UL_PIPE       _ UL_BSLH       _ UL_FSLH       _ LA(UL_LBRC)   _ LA(UL_RBRC)       _ LS(UL_COMMA)  _ UL_COMMA      _ MINUS         _ UNDER         _ UL_TILDE      &mo ADJ
// ╰───────────────┴───────────────┴───────────────┼───────────────┼───────────────┼───────────────┤   ├───────────────├───────────────┼───────────────┼───────────────┴───────────────┴───────────────╯
//                                                 │               │               │               │   │               │               │               │
                                                    _ LGUI          _ LSHFT         _ SPACE             _ ENTER         ___             _ RALT
//                                                 ╰───────────────┴───────────────┴───────────────╯   ╰───────────────┴───────────────┴───────────────╯
)

/**
 * NAV Layer
 */
ZMK_LAYER(nav,
// ╭───────────────┬───────────────┬───────────────┬───────────────┬───────────────┬───────────────╮   ╭───────────────┬───────────────┬───────────────┬───────────────┬───────────────┬───────────────╮
    _ ESC           XXX             _ UL_N7         _ UL_N8         _ UL_N9         _ UL_COMMA          XXX             _ PG_UP         XXX             _ PG_DN         XXX             _ BSPC
// ├───────────────├───────────────┼───────────────┼───────────────┼───────────────┼───────────────┤   ├───────────────├───────────────┼───────────────┼───────────────┼───────────────┼───────────────┤
    _ TAB           XXX             _ UL_N4         _ UL_N5         _ UL_N6         _ UL_DOT            XXX             _ LEFT          _ UP            _ RIGHT         XXX             _ DEL
// ├───────────────├───────────────┼───────────────┼───────────────┼───────────────┼───────────────┤   ├───────────────├───────────────┼───────────────┼───────────────┼───────────────┼───────────────┤
    _ LCTRL         XXX             _ UL_N1         _ UL_N2         _ UL_N3         _ UL_N0             XXX             _ HOME          _ DOWN          _ END           _ CAPS          &tog GAM
// ╰───────────────┴───────────────┴───────────────┼───────────────┼───────────────┼───────────────┤   ├───────────────├───────────────┼───────────────┼───────────────┴───────────────┴───────────────╯
                                                    _ LGUI          _ LSHFT         ___                 _ ENTER         ___             _ RALT
//                                                 ╰───────────────┴───────────────┴───────────────╯   ╰───────────────┴───────────────┴───────────────╯
)

/**
 * EXT Layer
 */
ZMK_LAYER(ext,
// ╭───────────────┬───────────────┬───────────────┬───────────────┬───────────────┬───────────────╮   ╭───────────────┬───────────────┬───────────────┬───────────────┬───────────────┬───────────────╮
    _ ESC           XXX             XXX             _ TAB_P         &swtn           XXX                 _ C_VOL_UP      XXX             XXX             XXX             _ C_BRI_UP      _ BSPC
// ├───────────────├───────────────┼───────────────┼───────────────┼───────────────┼───────────────┤   ├───────────────├───────────────┼───────────────┼───────────────┼───────────────┼───────────────┤
    _ TAB           XXX             _ SPACE_D       _ SPACE_P       _ SPACE_N       _ SPACE_U           _ C_VOL_DN      _ C_PREV        _ C_PP          _ C_NEXT        _ C_BRI_DN      _ DEL
// ├───────────────├───────────────┼───────────────┼───────────────┼───────────────┼───────────────┤   ├───────────────├───────────────┼───────────────┼───────────────┼───────────────┼───────────────┤
    _ LCTRL         XXX             XXX             _ WIN_P         &swwn           XXX                 _ C_MUTE        XXX             XXX             XXX             XXX             XXX
// ╰───────────────┴───────────────┴───────────────┼───────────────┼───────────────┼───────────────┤   ├───────────────├───────────────┼───────────────┼───────────────┴───────────────┴───────────────╯
                                                    _ LGUI          _ LSHFT         _ SPACE             ___             ___             _ RALT
//                                                 ╰───────────────┴───────────────┴───────────────╯   ╰───────────────┴───────────────┴───────────────╯
)

/**
 * GAM Layer
 */
ZMK_LAYER(game,
// ╭───────────────┬───────────────┬───────────────┬───────────────┬───────────────┬───────────────╮   ╭───────────────┬───────────────┬───────────────┬───────────────┬───────────────┬───────────────╮
    _ ESC           _ T             _ Q             _ W             _ E             _ R                 _ C_VOL_UP      XXX             XXX             XXX             XXX             _ BSPC
// ├───────────────├───────────────┼───────────────┼───────────────┼───────────────┼───────────────┤   ├───────────────├───────────────┼───────────────┼───────────────┼───────────────┼───────────────┤
    _ TAB           _ G             _ A             _ S             _ D             _ F                 _ C_VOL_DN      _ LEFT          _ UP            _ RIGHT         XXX             XXX
// ├───────────────├───────────────┼───────────────┼───────────────┼───────────────┼───────────────┤   ├───────────────├───────────────┼───────────────┼───────────────┼───────────────┼───────────────┤
    &mo GFN         _ B             _ Z             _ X             _ C             _ V                 _ C_MUTE        XXX             _ DOWN          XXX             XXX             &tog GAM
// ╰───────────────┴───────────────┴───────────────┼───────────────┼───────────────┼───────────────┤   ├───────────────├───────────────┼───────────────┼───────────────┴───────────────┴───────────────╯
                                                    _ LCTRL         _ LSHFT         _ SPACE             _ ENTER         XXX             _ RALT
//                                                 ╰───────────────┴───────────────┴───────────────╯   ╰───────────────┴───────────────┴───────────────╯
)

/**
 * GFN Layer
 */
ZMK_LAYER(gamefn,
// ╭───────────────┬───────────────┬───────────────┬───────────────┬───────────────┬───────────────╮   ╭───────────────┬───────────────┬───────────────┬───────────────┬───────────────┬───────────────╮
    ___             _ KP_N5         _ KP_N1         _ KP_N2         _ KP_N3         _ KP_N4             ___             ___             ___             ___             ___             ___
// ├───────────────├───────────────┼───────────────┼───────────────┼───────────────┼───────────────┤   ├───────────────├───────────────┼───────────────┼───────────────┼───────────────┼───────────────┤
    ___             _ KP_N0         _ KP_N6         _ KP_N7         _ KP_N8         _ KP_N9             ___             ___             ___             ___             ___             ___
// ├───────────────├───────────────┼───────────────┼───────────────┼───────────────┼───────────────┤   ├───────────────├───────────────┼───────────────┼───────────────┼───────────────┼───────────────┤
    ___             _ H             _ J             _ N             _ M             _ I                 ___             ___             ___             ___             ___             ___
// ╰───────────────┴───────────────┴───────────────┼───────────────┼───────────────┼───────────────┤   ├───────────────├───────────────┼───────────────┼───────────────┴───────────────┴───────────────╯
                                                    _ LALT          ___             _ ENTER             ___             ___             ___
//                                                 ╰───────────────┴───────────────┴───────────────╯   ╰───────────────┴───────────────┴───────────────╯
)

/**
 * Fn Layer
 */
ZMK_LAYER(fn,
// ╭───────────────┬───────────────┬───────────────┬───────────────┬───────────────┬───────────────╮   ╭───────────────┬───────────────┬───────────────┬───────────────┬───────────────┬───────────────╮
    XXX             _ F1            _ F2            _ F3            _ F4            _ F5                XXX             XXX             XXX             XXX             XXX             XXX
// ├───────────────├───────────────┼───────────────┼───────────────┼───────────────┼───────────────┤   ├───────────────├───────────────┼───────────────┼───────────────┼───────────────┼───────────────┤
    XXX             _ F6            _ F7            _ F8            _ F9            _ F10               XXX             XXX             XXX             XXX             XXX             XXX
// ├───────────────├───────────────┼───────────────┼───────────────┼───────────────┼───────────────┤   ├───────────────├───────────────┼───────────────┼───────────────┼───────────────┼───────────────┤
    XXX             _ F11           _ F12           _ F13           _ F14           _ F15               XXX             _ LSHFT         _ LCTRL         _ LALT          _ LGUI          ___
// ╰───────────────┴───────────────┴───────────────┼───────────────┼───────────────┼───────────────┤   ├───────────────├───────────────┼───────────────┼───────────────┴───────────────┴───────────────╯
                                                    ___             ___             ___                 ___             ___             ___
//                                                 ╰───────────────┴───────────────┴───────────────╯   ╰───────────────┴───────────────┴───────────────╯
)

/**
 * Mouse Layer
 */
ZMK_LAYER(mouse,
// ╭───────────────┬───────────────┬───────────────┬───────────────┬───────────────┬───────────────╮   ╭───────────────┬───────────────┬───────────────┬───────────────┬───────────────┬───────────────╮
    ___             XXX             XXX             XXX             XXX             XXX                 XXX             &msc SCRL_UP    &mkp MCLK       &msc SCRL_DOWN  XXX             XXX
// ├───────────────├───────────────┼───────────────┼───────────────┼───────────────┼───────────────┤   ├───────────────├───────────────┼───────────────┼───────────────┼───────────────┼───────────────┤
    XXX             XXX             XXX             XXX             XXX             XXX                 &msc SCRL_LEFT  &mmv MOVE_LEFT  &mmv MOVE_UP    &mmv MOVE_RIGHT &msc SCRL_RIGHT XXX
// ├───────────────├───────────────┼───────────────┼───────────────┼───────────────┼───────────────┤   ├───────────────├───────────────┼───────────────┼───────────────┼───────────────┼───────────────┤
    XXX             XXX             XXX             XXX             XXX             XXX                 &mkp MB4        &mkp MB5        &mmv MOVE_DOWN  XXX             XXX             XXX
// ╰───────────────┴───────────────┴───────────────┼───────────────┼───────────────┼───────────────┤   ├───────────────├───────────────┼───────────────┼───────────────┴───────────────┴───────────────╯
                                                    _ LGUI          _ LSHFT         XXX                 &mkp LCLK       &mkp RCLK       ___
//                                                 ╰───────────────┴───────────────┴───────────────╯   ╰───────────────┴───────────────┴───────────────╯
)

/**
 * ADJ Layer
 */
ZMK_LAYER(adjust,
// ╭───────────────┬───────────────┬───────────────┬───────────────┬───────────────┬───────────────╮   ╭───────────────┬───────────────┬───────────────┬───────────────┬───────────────┬───────────────╮
    ___             &bootloader     XXX             &sys_reset      XXX             &out OUT_TOG        &out OUT_TOG    XXX             &sys_reset      XXX             &bootloader     XXX
// ├───────────────├───────────────┼───────────────┼───────────────┼───────────────┼───────────────┤   ├───────────────├───────────────┼───────────────┼───────────────┼───────────────┼───────────────┤
    XXX             &bt BT_SEL 0    &bt BT_SEL 1    &bt BT_SEL 2    &bt BT_SEL 3    &bt BT_SEL 4        &bt BT_SEL 4    &bt BT_SEL 3    &bt BT_SEL 2    &bt BT_SEL 1    &bt BT_SEL 0    XXX
// ├───────────────├───────────────┼───────────────┼───────────────┼───────────────┼───────────────┤   ├───────────────├───────────────┼───────────────┼───────────────┼───────────────┼───────────────┤
    XXX             XXX             XXX             XXX             XXX             &bt BT_CLR          &bt BT_CLR      XXX             XXX             XXX             XXX             ___
// ╰───────────────┴───────────────┴───────────────┼───────────────┼───────────────┼───────────────┤   ├───────────────├───────────────┼───────────────┼───────────────┴───────────────┴───────────────╯
                                                    ___             ___             ___                 ___             ___             ___
//                                                 ╰───────────────┴───────────────┴───────────────╯   ╰───────────────┴───────────────┴───────────────╯
)
