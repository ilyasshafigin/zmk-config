/**
 * Mouse Layer
 */

ZMK_LAYER(mse,
// ╭───────────────┬───────────────┬───────────────┬───────────────┬───────────────┬───────────────╮   ╭───────────────┬───────────────┬───────────────┬───────────────┬───────────────┬───────────────╮
// │0              │1              │2              │3              │4              │5              │   │6              │7              │8              │9              │10             │11             │
    &trans          &none           &none           &none           &none           &none               &mkp MB5        &msc SCRL_UP    &mkp MCLK       &none           &none           &none
// ├───────────────├───────────────┼───────────────┼───────────────┼───────────────┼───────────────┤   ├───────────────├───────────────┼───────────────┼───────────────┼───────────────┼───────────────┤
// │12             │13             │14             │15             │16             │17             │   │18             │19             │20             │21             │22             │23             │
    &none           &none           &none           &none           &none           &none               &msc SCRL_LEFT  &mmv MOVE_LEFT  &mmv MOVE_UP    &mmv MOVE_RIGHT &msc SCRL_RIGHT &none
// ├───────────────├───────────────┼───────────────┼───────────────┼───────────────┼───────────────┤   ├───────────────├───────────────┼───────────────┼───────────────┼───────────────┼───────────────┤
// │24             │25             │26             │27             │28             │29             │   │30             │31             │32             │33             │34             │35             │
    &none           &none           &none           &none           &none           &none               &mkp MB4        &msc SCRL_DOWN  &mmv MOVE_DOWN  &none           &none           &none
// ╰───────────────┴───────────────┴───────────────┼───────────────┼───────────────┼───────────────┤   ├───────────────├───────────────┼───────────────┼───────────────┴───────────────┴───────────────╯
//                                                 │36             │37             │38             │   │39             │40             │41             │
                                                    &none           &none           &none               &mkp LCLK       &mkp RCLK       &trans
//                                                 ╰───────────────┴───────────────┴───────────────╯   ╰───────────────┴───────────────┴───────────────╯
)
