/**
 * SYM Layer
 */

ZMK_LAYER(sym,
// ╭───────────────┬───────────────┬───────────────┬───────────────┬───────────────┬───────────────╮   ╭───────────────┬───────────────┬───────────────┬───────────────┬───────────────┬───────────────╮
// │0            ^ │1            $ │2            # │3            @ │4            ( │5            ) │   │6            ! │7            7 │8            8 │9            9 │10           - │11           + │
    &kp N6          &kp N4          &kp N3          &kp N2          &kp N9          &kp N0              &kp N1          &kp LS(N7)       &kp LS(N8)     &kp LS(N9)      &kp MINUS       &kp PLUS
// ├───────────────├───────────────┼───────────────┼───────────────┼───────────────┼───────────────┤   ├───────────────├───────────────┼───────────────┼───────────────┼───────────────┼───────────────┤
// │12           ~ │13           ` │14           ' │15           " │16           [ │17           ] │   │18           ? │19           4 │20           5 │21           6 │22           * │23           = │
  &mt LALT UL_TILDE &kp UL_GRAVE    &kp UL_SQT      &kp UL_DQT      &kp LBKT        &kp RBKT            &kp N7          &kp LS(N4)      &kp LS(N5)      &kp LS(N6)      &kp N8          &mt RALT EQUAL
// ├───────────────├───────────────┼───────────────┼───────────────┼───────────────┼───────────────┤   ├───────────────├───────────────┼───────────────┼───────────────┼───────────────┼───────────────┤
// │24           ¦ │25           | │26           \ │27           / │28           { │29           } │   │30           0 │31           1 │32           2 │33           3 │34           _ │35           % │
   &mt LCTRL UL_DDV &kp UL_PIPE     &kp UL_BSLH     &kp UL_FSLH     &kp LBRC        &kp RBRC            &kp LS(N0)      &kp LS(N1)      &kp LS(N2)      &kp LS(N3)      &kp UNDER       &mt RCTRL N5
// ╰───────────────┴───────────────┴───────────────┼───────────────┼───────────────┼───────────────┤   ├───────────────├───────────────┼───────────────┼───────────────┴───────────────┴───────────────╯
//                                                 │36             │37             │38             │   │39             │40             │41             │
                                                    &trans          &trans          &trans              &trans          &trans          &trans
//                                                 ╰───────────────┴───────────────┴───────────────╯   ╰───────────────┴───────────────┴───────────────╯
)
