/**
 * GAM Layer
 */

ZMK_LAYER(gam,
// ╭───────────────┬───────────────┬───────────────┬───────────────┬───────────────┬───────────────╮   ╭───────────────┬───────────────┬───────────────┬───────────────┬───────────────┬───────────────╮
// │0              │1              │2              │3              │4              │5              │   │6              │7              │8              │9              │10             │11             │
    &kp ESC         &kp T           &kp Q           &kp W           &kp E           &kp R               &none           &none           &none           &none           &none           &none
// ├───────────────├───────────────┼───────────────┼───────────────┼───────────────┼───────────────┤   ├───────────────├───────────────┼───────────────┼───────────────┼───────────────┼───────────────┤
// │12             │13             │14             │15             │16             │17             │   │18             │19             │20             │21             │22             │23             │
    &kp TAB         &kp G           &kp A           &kp S           &kp D           &kp F               &none           &kp LEFT        &kp UP          &kp RIGHT       &none           &to DEF
// ├───────────────├───────────────┼───────────────┼───────────────┼───────────────┼───────────────┤   ├───────────────├───────────────┼───────────────┼───────────────┼───────────────┼───────────────┤
// │24             │25             │26             │27             │28             │29             │   │30             │31             │32             │33             │34             │35             │
    &kp LCTRL       &kp B           &kp Z           &kp X           &kp C           &kp V               &none           &none           &kp DOWN        &none           &none           &none
// ╰───────────────┴───────────────┴───────────────┼───────────────┼───────────────┼───────────────┤   ├───────────────├───────────────┼───────────────┼───────────────┴───────────────┴───────────────╯
//                                                 │36             │37             │38             │   │39             │40             │41             │
                                                    &mo GFN         &kp LSHFT       &kp SPACE           &kp ENTER       &none           &kp RALT
//                                                 ╰───────────────┴───────────────┴───────────────╯   ╰───────────────┴───────────────┴───────────────╯
)
