// ZMK Behaviors Configuration
&mt {
    flavor = "balanced";
    tapping-term-ms = <TAPPING_TERM_MS>;
    quick-tap-ms = <QUICK_TAP_MS>;
    require-prior-idle-ms = <REQUIRE_PRIOR_IDLE_MS>;
}; 

&lt {
    flavor = "balanced";
    tapping-term-ms = <TAPPING_TERM_MS>;
    quick-tap-ms = <QUICK_TAP_MS>;
    require-prior-idle-ms = <REQUIRE_PRIOR_IDLE_MS>;
};

&sk {
    release-after-ms = <RELEASE_AFTER_KEY_MS>;
    quick-release;
};

ZMK_SMART_TOGGLE(swtn,
    bindings = <&kp LCTRL>, <&kp TAB>;
    ignored-key-positions = <LT1 LT2>;
)

ZMK_SMART_TOGGLE(swwn,
    bindings = <&kp LGUI>, <&kp TAB>;
    ignored-key-positions = <LB1 LB2>;
)
