/*
  ╭─────────────────────────┬─────────────────────────╮
  │ LT5 LT4 LT3 LT2 LT1 LT0 │ RT0 RT1 RT2 RT3 RT4 RT5 │
  │ LM5 LM4 LM3 LM2 LM1 LM0 │ RM0 RM1 RM2 RM3 RM4 RM5 │
  │ LB5 LB4 LB3 LB2 LB1 LB0 │ RB0 RB1 RB2 RB3 RB4 RB5 │
  ╰───────────╮ LH2 LH1 LH0 │ RH0 RH1 RH2 ╭───────────╯
              ╰─────────────┴─────────────╯
*/

#include "../includes/base.h"
#include "zmk-helpers/key-labels/42.h"
#include "behaviors.dtsi"
#include "macros.dtsi"
#include "combos.dtsi"
#include "conditional_layers.dtsi"
#include "mouse.dtsi"
#include "layers.dtsi"
