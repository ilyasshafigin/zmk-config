#include "includes/behaviors.dtsi"
#include "includes/keys.h"
#include "includes/layers.h"
#include "zmk-helpers/key-labels/totem.h"

/*
      ╭─────────────────────┬─────────────────────╮
      │ LT4 LT3 LT2 LT1 LT0 │ RT0 RT1 RT2 RT3 RT4 │
  ╭───╯ LM4 LM3 LM2 LM1 LM0 │ RM0 RM1 RM2 RM3 RM4 ╰───╮
  │ LB5 LB4 LB3 LB2 LB1 LB0 │ RB0 RB1 RB2 RB3 RB4 RB5 │
  ╰───────────╮ LH2 LH1 LH0 │ RH0 RH1 RH2 ╭───────────╯
              ╰─────────────┴─────────────╯
*/

MAKE_HRM(hml,   &kp, &kp,   KEYS_R THUMBS)
MAKE_HRM(hml_h, &kp, &none, KEYS_R THUMBS)
MAKE_HRM(hmr,   &kp, &kp,   KEYS_L THUMBS)
MAKE_HRM(hmr_h, &kp, &none, KEYS_L THUMBS)

ZMK_SMART_TOGGLE(tabber,
    bindings = <&kp LCTRL>, <&kp TAB>;
    ignored-key-positions = <LM0 LH1>;
)

ZMK_SMART_TOGGLE(swapper,
    bindings = <&kp LGUI>, <&kp TAB>;
    ignored-key-positions = <LB0 LH1>;
)

ZMK_MACRO(double_ctrl,
    bindings = <&macro_tap>,
               <&kp LCTRL>,
               <&macro_tap>,
               <&kp LCTRL>;
)

ZMK_MACRO(double_shft,
    bindings = <&macro_tap>,
               <&kp LSHFT>,
               <&macro_tap>,
               <&kp LSHFT>;
)

ZMK_MACRO(double_gui,
    bindings = <&macro_tap>,
               <&kp LGUI>,
               <&macro_tap>,
               <&kp LGUI>;
)

ZMK_COMBO(para_left,      &kp UL_LPAR,    LT1 LT0,    DEF SYM,  COMBO_TERM, COMBO_IDLE)
ZMK_COMBO(para_right,     &kp UL_RPAR,    RT0 RT1,    DEF SYM,  COMBO_TERM, COMBO_IDLE)
ZMK_COMBO(brak_left,      &kp UL_LBKT,    LM1 LM0,    DEF SYM,  COMBO_TERM, COMBO_IDLE)
ZMK_COMBO(brak_right,     &kp UL_RBKT,    RM0 RM1,    DEF SYM,  COMBO_TERM, COMBO_IDLE)
ZMK_COMBO(brace_left,     &kp UL_LBRC,    LB1 LB0,    DEF SYM,  COMBO_TERM, COMBO_IDLE)
ZMK_COMBO(brace_right,    &kp UL_RBRC,    RB0 RB1,    DEF SYM,  COMBO_TERM, COMBO_IDLE)
ZMK_COMBO(single_quote,   &kp UL_SQT,     LB2 LB1,    DEF SYM,  COMBO_TERM, COMBO_IDLE)
ZMK_COMBO(double_quote,   &kp UL_DQT,     RB1 RB2,    DEF SYM,  COMBO_TERM, COMBO_IDLE)
ZMK_COMBO(grave,          &kp UL_GRAVE,   LT2 LT1,    DEF SYM,  COMBO_TERM, COMBO_IDLE)
ZMK_COMBO(tilde,          &kp UL_TILDE,   RT1 RT2,    DEF SYM,  COMBO_TERM, COMBO_IDLE)
ZMK_COMBO(backslash,      &kp UL_BSLH,    LM3 LM2,    DEF SYM,  COMBO_TERM, COMBO_IDLE)
ZMK_COMBO(slash,          &kp UL_FSLH,    RM2 RM3,    DEF SYM,  COMBO_TERM, COMBO_IDLE)
ZMK_COMBO(arrow,          &kp LS(LA(K)),  LT3 LT2,    DEF SYM,  COMBO_TERM, COMBO_IDLE)
ZMK_COMBO(double_arrow,   &kp LA(K),      RT2 RT3,    DEF SYM,  COMBO_TERM, COMBO_IDLE)
ZMK_COMBO(lang_ru,        &kp LG(F11),    LM2 LM1,    DEF SYM,  COMBO_TERM, COMBO_IDLE)
ZMK_COMBO(lang_en,        &kp LG(F12),    RM1 RM2,    DEF SYM,  COMBO_TERM, COMBO_IDLE)
//ZMK_COMBO(layer_game,     &tog GAM,       RT3 RT4,    DEF,      COMBO_TERM, COMBO_IDLE)
//ZMK_COMBO(esc,            &kp ESC,        LT3 LT4,    DEF SYM,  COMBO_TERM, COMBO_IDLE)
//ZMK_COMBO(tab,            &kp TAB,        LM3 LM4,    DEF SYM,  COMBO_TERM, COMBO_IDLE)

ZMK_CONDITIONAL_LAYER(fn_layer, NAV SYM, NUM)

/**
 * Default Layer - QWERTY
 */
ZMK_LAYER(base,
//           ╭───────────────┬───────────────┬───────────────┬───────────────┬───────────────╮   ╭───────────────┬───────────────┬───────────────┬───────────────┬───────────────╮
//           │           Q Й │           W Ц │           E У │           R К │           T Е │   │           Y Н │           U Г │           I Ш │           O З │           P Х │
              _ Q             _ W             _ E             _ R             _ T                 _ Y             _ U             _ I             _ O             _ P
//           ├───────────────┼───────────────┼───────────────┼───────────────┼───────────────┤   ├───────────────┼───────────────┼───────────────┼───────────────┼───────────────┤
//           │ GUI       A Ф │ ALT       S Ы │ CTRL      D В │ SHIFT     F А │           G П │   │           H Р │ SHIFT     J О │ CTRL      K Л │ ALT       L Д │ GUI       ~ Ж │
              &hml LGUI A     &hml LALT S     &hml LCTRL D    &hml LSHFT F    _ G                 _ H             &hmr LSHFT J    &hmr LCTRL K    &hmr LALT L     &hmr LGUI UL_TILDE
// ╭─────────┼───────────────┼───────────────┼───────────────┼───────────────┼───────────────┤   ├───────────────┼───────────────┼───────────────┼───────────────┼───────────────┼─────────╮
// │         │           Z Я │           X Ч │           C С │           V М │           B И │   │           N Т │           M Ь │           & Б │           [ Ю │           ] Э │       / │
    _ LCTRL   _ Z             _ X             _ C             _ V             _ B                 _ N             _ M             _ UL_AMPS       _ UL_LBKT       _ UL_RBKT       _ UL_FSLH
// ╰─────────┴───────────────┴───────────────┼───────────────┼───────────────┼───────────────┤   ├───────────────┼───────────────┼───────────────┼───────────────┴───────────────┴─────────╯
//                                           │               │               │               │   │               │               │               │
                                              _ LGUI          &mt LSHFT SPACE &mo NAV             &mo SYM         &lt CMD BSPC    &mo ALT
//                                           ╰───────────────┴───────────────┴───────────────╯   ╰───────────────┴───────────────┴───────────────╯
)

/**
 * SYM Layer
 */
ZMK_LAYER(symbol,
//           ╭──────────────────┬──────────────────┬──────────────────┬──────────────────┬───────────────╮   ╭───────────────┬──────────────────┬──────────────────┬──────────────────┬──────────────────╮
//           │                ^ │                @ │                # │                $ │             ( │   │             ) │                ? │                ! │                * │                % │
              _ UL_CARET         _ UL_AT            _ UL_HASH          _ UL_DLLR          _ UL_LPAR           _ UL_RPAR       _ UL_QSTM          _ UL_EXCL          _ UL_ASTRK         _ UL_PRCNT
//           ├──────────────────┼──────────────────┼──────────────────┼──────────────────┼───────────────┤   ├───────────────┼──────────────────┼──────────────────┼──────────────────┼──────────────────┤
//           │ GUI          ~ Ж │ ALT            ` │ CTRL           ' │ SHIFT          " │             [ │   │             ] │ SHIFT          . │ CTRL           : │ ALT            + │ GUI            = │
              &hml LGUI UL_TILDE &hml LALT UL_GRAVE &hml LCTRL UL_SQT  &hml LSHFT UL_DQT  _ LA(UL_LBKT)       _ LA(UL_RBKT)   &hmr LSHFT UL_DOT  &hmr LCTRL LS(UL_DOT) &hmr LALT PLUS  &hmr LGUI EQUAL
// ╭─────────┼──────────────────┼──────────────────┼──────────────────┼──────────────────┼───────────────┤   ├───────────────┼──────────────────┼──────────────────┼──────────────────┼──────────────────┼─────────╮
// │         │               -> │                | │                \ │                / │             { │   │             } │                , │                ; │                - │                _ │         │
    ___       _ LS(LA(K))        _ UL_PIPE          _ UL_BSLH          _ UL_FSLH          _ LA(UL_LBRC)       _ LA(UL_RBRC)   _ UL_COMMA         _ LS(UL_COMMA)     _ MINUS            _ UNDER            XXX
// ╰─────────┴──────────────────┴──────────────────┼──────────────────┼──────────────────┼───────────────┤   ├───────────────┼──────────────────┼──────────────────┼──────────────────┴──────────────────┴─────────╯
//                                                 │                  │                  │               │   │               │                  │                  │
                                                    ___                &mt LSHFT UL_NBSP  ___                 ___             _ BSPC             ___
//                                                 ╰──────────────────┴──────────────────┴───────────────╯   ╰───────────────┴──────────────────┴──────────────────╯
)

/**
 * NAV Layer
 */
ZMK_LAYER(nav,
//           ╭──────────────────┬──────────────────┬──────────────────┬──────────────────┬───────────────╮   ╭───────────────┬──────────────────┬──────────────────┬──────────────────┬───────────────╮
              _ UL_COMMA         _ UL_N7            _ UL_N8            _ UL_N9            _ ESC               _ BSPC          _ PG_UP            XXX                _ PG_DN            &tog GAM
//           ├──────────────────┼──────────────────┼──────────────────┼──────────────────┼───────────────┤   ├───────────────┼──────────────────┼──────────────────┼──────────────────┼───────────────┤
              &hml LGUI UL_DOT   &hml LALT UL_N4    &hml LCTRL UL_N5   &hml LSHFT UL_N6   _ TAB               _ DEL           &hmr LSHFT LEFT    &hmr LCTRL UP      &hmr LALT RIGHT    &hmr LGUI APOS
// ╭─────────┼──────────────────┼──────────────────┼──────────────────┼──────────────────┼───────────────┤   ├───────────────┼──────────────────┼──────────────────┼──────────────────┼───────────────┼─────────╮
    ___       _ UL_N0            _ UL_N1            _ UL_N2            _ UL_N3            _ ENTER             _ ENTER         _ HOME             _ DOWN             _ END              &caps_word      XXX
// ╰─────────┴──────────────────┴──────────────────┼──────────────────┼──────────────────┼───────────────┤   ├───────────────┼──────────────────┼──────────────────┼──────────────────┴───────────────┴─────────╯
                                                    ___                ___                ___                 ___             ___                ___
//                                                 ╰──────────────────┴──────────────────┴───────────────╯   ╰───────────────┴──────────────────┴──────────────────╯
)

/**
 * NUM Layer
 */
ZMK_LAYER(num,
//          ╭───────────────┬───────────────┬───────────────┬───────────────┬───────────────╮   ╭───────────────┬───────────────┬───────────────┬───────────────┬───────────────╮
             _ KP_COMMA      _ KP_N7         _ KP_N8         _ KP_N9         XXX                 _ F10           _ F9            _ F8            _ F7            _ F13
//          ├───────────────┼───────────────┼───────────────┼───────────────┼───────────────┤   ├───────────────┼───────────────┼───────────────┼───────────────┼───────────────┤
             &hml LGUI KP_DOT &hml LALT KP_N4 &hml LCTRL KP_N5 &hml LSHFT KP_N6 XXX              _ F11           &hmr LSHFT F6   &hmr LCTRL F5   &hmr LALT F4    &hmr LGUI F14
// ╭────────┼───────────────┼───────────────┼───────────────┼───────────────┼───────────────┤   ├───────────────┼───────────────┼───────────────┼───────────────┼───────────────┼─────────╮
    XXX      _ KP_N0         _ KP_N1         _ KP_N2         _ KP_N3         XXX                 _ F12           _ F3            _ F2            _ F1            _ F15           XXX
// ╰────────┴───────────────┴───────────────┼───────────────┼───────────────┼───────────────┤   ├───────────────┼───────────────┼───────────────┼───────────────┴───────────────┴─────────╯
                                             ___             ___             ___                 ___             ___             ___
//                                          ╰───────────────┴───────────────┴───────────────╯   ╰───────────────┴───────────────┴───────────────╯
)

/**
 * GAM Layer
 */
ZMK_LAYER(game,
//           ╭───────────────┬───────────────┬───────────────┬───────────────┬───────────────╮   ╭───────────────┬───────────────┬───────────────┬───────────────┬───────────────╮
              _ ESC           _ Q             _ W             _ E             _ R                 XXX             _ C_VOL_DN      _ C_VOL_UP      _ C_MUTE        &tog GAM
//           ├───────────────┼───────────────┼───────────────┼───────────────┼───────────────┤   ├───────────────┼───────────────┼───────────────┼───────────────┼───────────────┤
              _ TAB           _ A             _ S             _ D             _ F                 XXX             _ LEFT          _ UP            _ RIGHT         XXX
// ╭─────────┼───────────────┼───────────────┼───────────────┼───────────────┼───────────────┤   ├───────────────┼───────────────┼───────────────┼───────────────┼───────────────┼─────────╮
    _ LCTRL   _ LCTRL         _ Z             _ X             _ C             _ V                 XXX             XXX             _ DOWN          XXX             XXX             XXX
// ╰─────────┴───────────────┴───────────────┼───────────────┼───────────────┼───────────────┤   ├───────────────┼───────────────┼───────────────┼───────────────┴───────────────┴─────────╯
                                              _ LSHFT         _ SPACE         &mo GFN             _ ENTER         _ BSPC          _ LALT
//                                           ╰───────────────┴───────────────┴───────────────╯   ╰───────────────┴───────────────┴───────────────╯
)

/**
 * GFN Layer
 */
ZMK_LAYER(gamefn,
//           ╭───────────────┬───────────────┬───────────────┬───────────────┬───────────────╮   ╭───────────────┬───────────────┬───────────────┬───────────────┬───────────────╮
              _ M             _ UL_N7         _ UL_N8         _ UL_N9         _ T                 _ Y             _ U             _ I             _ O             _ P
//           ├───────────────┼───────────────┼───────────────┼───────────────┼───────────────┤   ├───────────────┼───────────────┼───────────────┼───────────────┼───────────────┤
              _ I             _ UL_N4         _ UL_N5         _ UL_N6         _ G                 _ H             _ J             _ K             _ L             XXX
// ╭─────────┼───────────────┼───────────────┼───────────────┼───────────────┼───────────────┤   ├───────────────┼───────────────┼───────────────┼───────────────┼───────────────┼─────────╮
    ___       _ UL_N0         _ UL_N1         _ UL_N2         _ UL_N3         _ B                 _ N             _ M             XXX             XXX             XXX             XXX
// ╰─────────┴───────────────┴───────────────┼───────────────┼───────────────┼───────────────┤   ├───────────────┼───────────────┼───────────────┼───────────────┴───────────────┴─────────╯
                                              _ LALT          _ ENTER         ___                 ___             ___             ___
//                                           ╰───────────────┴───────────────┴───────────────╯   ╰───────────────┴───────────────┴───────────────╯
)

/**
 * ALT Layer
 */
ZMK_LAYER(alt,
//           ╭───────────────┬───────────────┬───────────────┬───────────────┬───────────────╮   ╭───────────────┬───────────────┬───────────────┬───────────────┬───────────────╮
              _ RA(Q)         _ RA(W)         _ RA(E)         _ RA(R)         _ RA(T)             _ RA(Y)         _ RA(U)         _ RA(I)         _ RA(O)         _ RA(P)
//           ├───────────────┼───────────────┼───────────────┼───────────────┼───────────────┤   ├───────────────┼───────────────┼───────────────┼───────────────┼───────────────┤
              _ RA(A)         _ RA(S)         _ RA(D)         _ RA(F)         _ RA(G)             _ RA(H)         _ RA(J)         _ RA(K)         _ RA(L)         _ RA(UL_TILDE)
// ╭─────────┼───────────────┼───────────────┼───────────────┼───────────────┼───────────────┤   ├───────────────┼───────────────┼───────────────┼───────────────┼───────────────┼─────────╮
    XXX       _ RA(Z)         _ RA(X)         _ RA(C)         _ RA(V)         _ RA(B)             _ RA(N)         _ RA(M)         _ RA(UL_AMPS)   _ RA(UL_LBKT)   _ RA(UL_RBKT)   XXX
// ╰─────────┴───────────────┴───────────────┼───────────────┼───────────────┼───────────────┤   ├───────────────┼───────────────┼───────────────┼───────────────┴───────────────┴─────────╯
                                              ___             _ UL_NBSP       _ LSHFT             ___             ___             ___
//                                           ╰───────────────┴───────────────┴───────────────╯   ╰───────────────┴───────────────┴───────────────╯
)


/**
 * CMD Layer
 */
ZMK_LAYER(cmd,
//           ╭───────────────┬───────────────┬───────────────┬───────────────┬───────────────╮   ╭───────────────┬───────────────┬───────────────┬───────────────┬───────────────╮
              &bootloader     &bt BT_SEL 0    &bt BT_SEL 1    &bt BT_SEL 2    &bt BT_CLR          &out OUT_TOG    _ C_VOL_DN      _ C_VOL_UP      _ C_MUTE        &bootloader
//           ├───────────────┼───────────────┼───────────────┼───────────────┼───────────────┤   ├───────────────┼───────────────┼───────────────┼───────────────┼───────────────┤
              &sys_reset      XXX             _ SPACE_P       _ SPACE_N       &tabber             _ SPACE_U       _ C_PREV        _ C_NEXT        _ C_PP          &sys_reset
// ╭─────────┼───────────────┼───────────────┼───────────────┼───────────────┼───────────────┤   ├───────────────┼───────────────┼───────────────┼───────────────┼───────────────┼─────────╮
    ___       &double_ctrl    &double_shft    &double_gui     XXX             &swapper            _ SPACE_D       _ C_BRI_DN      _ C_BRI_UP      XXX             &soft_off       XXX
// ╰─────────┴───────────────┴───────────────┼───────────────┼───────────────┼───────────────┤   ├───────────────┼───────────────┼───────────────┼───────────────┴───────────────┴─────────╯
                                              ___             ___             ___                 ___             ___             ___
//                                           ╰───────────────┴───────────────┴───────────────╯   ╰───────────────┴───────────────┴───────────────╯
)
