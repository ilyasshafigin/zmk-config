#if defined(K_HAS_POINTER)
#include <dt-bindings/zmk/pointing.h>
#endif
#include <behaviors/brightness.dtsi>
#include "behaviors.dtsi"
#include "keys.h"
#include "layers.h"

/*
  ╭─────────────────────┬─────────────────────╮
  │ LT4 LT3 LT2 LT1 LT0 │ RT0 RT1 RT2 RT3 RT4 │
  │ LM4 LM3 LM2 LM1 LM0 │ RM0 RM1 RM2 RM3 RM4 │
  │ LB4 LB3 LB2 LB1 LB0 │ RB0 RB1 RB2 RB3 RB4 │
  ╰───────╮ LH2 LH1 LH0 │ RH0 RH1 RH2 ╭───────╯
          ╰─────────────┴─────────────╯
*/

MAKE_HRM(hml, &kp, &kp, KEYS_R THUMBS)
MAKE_HRM(hmr, &kp, &kp, KEYS_L THUMBS)

ZMK_SMART_TOGGLE(tabber,
    bindings = <&kp LCTRL>, <&kp TAB>;
    ignored-key-positions = <LM0 LH1>;
)

ZMK_SMART_TOGGLE(swapper,
    bindings = <&kp LGUI>, <&kp TAB>;
    ignored-key-positions = <LB0 LH1>;
)

#if defined(K_HAS_POINTER)
// hold - mo layer, tap - to layer
ZMK_HOLD_TAP(ht_two,
    bindings = <&mo>, <&to>; // hold, tap
    flavor = "balanced";
    tapping-term-ms = <TAPPING_TERM_FAST_MS>;
)

// hold - MSE, tap - to DEF, double tap - tog MSE
ZMK_TAP_DANCE(td_mse,
    bindings = <&ht_two MSE DEF>, <&tog MSE>;
    tapping-term-ms = <TAPPING_TERM_FAST_MS>;
)
#endif

ZMK_COMBO(para_left,      &kp U_LPAR,    LT1 LT0,    DEF SYM,  COMBO_TERM, COMBO_IDLE)
ZMK_COMBO(para_right,     &kp U_RPAR,    RT0 RT1,    DEF SYM,  COMBO_TERM, COMBO_IDLE)
ZMK_COMBO(brak_left,      &kp U_LBKT,    LM1 LM0,    DEF SYM,  COMBO_TERM, COMBO_IDLE)
ZMK_COMBO(brak_right,     &kp U_RBKT,    RM0 RM1,    DEF SYM,  COMBO_TERM, COMBO_IDLE)
ZMK_COMBO(brace_left,     &kp U_LBRC,    LB1 LB0,    DEF SYM,  COMBO_TERM, COMBO_IDLE)
ZMK_COMBO(brace_right,    &kp U_RBRC,    RB0 RB1,    DEF SYM,  COMBO_TERM, COMBO_IDLE)
//ZMK_COMBO(single_quote,   &kp U_SQT,     LB2 LB1,    DEF SYM,  COMBO_TERM, COMBO_IDLE)
//ZMK_COMBO(double_quote,   &kp U_DQT,     RB1 RB2,    DEF SYM,  COMBO_TERM, COMBO_IDLE)
ZMK_COMBO(grave,          &kp U_GRAVE,   LT2 LT1,    DEF SYM,  COMBO_TERM, COMBO_IDLE)
ZMK_COMBO(tilde,          &kp U_TILDE,   RT1 RT2,    DEF SYM,  COMBO_TERM, COMBO_IDLE)
//ZMK_COMBO(backslash,      &kp U_BSLH,    LM3 LM2,    DEF SYM,  COMBO_TERM, COMBO_IDLE)
//ZMK_COMBO(slash,          &kp U_FSLH,    RM2 RM3,    DEF SYM,  COMBO_TERM, COMBO_IDLE)
ZMK_COMBO(arrow,          &kp U_ARROW,   LT3 LT2,    DEF SYM,  COMBO_TERM, COMBO_IDLE)
ZMK_COMBO(double_arrow,   &kp U_DARROW,  RT2 RT3,    DEF SYM,  COMBO_TERM, COMBO_IDLE)
ZMK_COMBO(lang_ru,        &kp LANG_RU,    LM2 LM1,    DEF SYM,  COMBO_TERM, COMBO_IDLE)
ZMK_COMBO(lang_en,        &kp LANG_EN,    RM1 RM2,    DEF SYM,  COMBO_TERM, COMBO_IDLE)
//ZMK_COMBO(layer_game,     &tog GAM,       RT3 RT4,    DEF,      COMBO_TERM, COMBO_IDLE)
//ZMK_COMBO(esc,            &kp ESC,        LT3 LT4,    DEF SYM,  COMBO_TERM, COMBO_IDLE)
//ZMK_COMBO(tab,            &kp TAB,        LM3 LM4,    DEF SYM,  COMBO_TERM, COMBO_IDLE)

#if defined(K_HAS_POINTER)
ZMK_COMBO(left_click_l,   &mkp LCLK,      LB2 LB1,    DEF SYM NAV MSE SLOW SCRL CARE, COMBO_TERM, COMBO_IDLE)
ZMK_COMBO(left_click_r,   &mkp LCLK,      RB2 RB1,    DEF SYM NAV MSE SLOW SCRL CARE, COMBO_TERM, COMBO_IDLE)
ZMK_COMBO(right_click_l,  &mkp RCLK,      LB3 LB2,    DEF SYM NAV MSE SLOW SCRL CARE, COMBO_TERM, COMBO_IDLE)
ZMK_COMBO(right_click_r,  &mkp RCLK,      RB3 RB2,    DEF SYM NAV MSE SLOW SCRL CARE, COMBO_TERM, COMBO_IDLE)
ZMK_COMBO(middle_click_l, &mkp MCLK,      LM3 LM2,    DEF SYM NAV MSE SLOW SCRL CARE, COMBO_TERM, COMBO_IDLE)
ZMK_COMBO(middle_click_r, &mkp MCLK,      RM3 RM2,    DEF SYM NAV MSE SLOW SCRL CARE, COMBO_TERM, COMBO_IDLE)
#endif

#if defined(K_HAS_POINTER)
#define K_PLT(layer, key) &lt layer key
#define K_P(exp, no_exp) exp
#define K_LCLK      &mkp LCLK
#define K_RCLK      &mkp RCLK
#define K_MCLK      &mkp MCLK
#else
#define K_PLT(layer, key) _ key
#define K_P(exp, no_exp) no_exp
#define K_LCLK      XXX
#define K_RCLK      XXX
#define K_MCLK      XXX
#endif

#if defined(K_NONE_RH2)
#define K_RH2(exp, no_exp) no_exp
#else
#define K_RH2(exp, no_exp) exp
#endif

/**
 * Default Layer - QWERTY
 */
ZMK_LAYER(base, K_MAPPING(
// ╭──────────────────┬──────────────────┬──────────────────┬──────────────────┬───────────────╮   ╭───────────────┬──────────────────┬──────────────────┬──────────────────┬──────────────────╮
// │              Q Й │              W Ц │              E У │              R К │           T Е │   │           Y Н │              U Г │              I Ш │              O З │              P Х │
    _ Q,               _ W,               _ E,               _ R,               _ T,                _ Y,            _ U,            _ I,            _ O,            _ P,
// ├──────────────────┼──────────────────┼──────────────────┼──────────────────┼───────────────┤   ├───────────────┼──────────────────┼──────────────────┼──────────────────┼──────────────────┤
// │ GUI          A Ф │ ALT          S Ы │ CTRL         D В │ SHIFT        F А │           G П │   │           H Р │ SHIFT        J О │ CTRL         K Л │ ALT          L Д │ GUI          ~ Ж │
    &hml LGUI A,       &hml LALT S,       &hml LCTRL D,      &hml LSHFT F,      _ G,                _ H,            &hmr LSHFT J,      &hmr LCTRL K,      &hmr LALT L,       &hmr LGUI U_TILDE,
// ├──────────────────┼──────────────────┼──────────────────┼──────────────────┼───────────────┤   ├───────────────┼──────────────────┼──────────────────┼──────────────────┼──────────────────┤
// │              Z Я │              X Ч │              C С │              V М │           B И │   │           N Т │              M Ь │              & Б │              [ Ю │              ] Э │
    _ Z,               K_PLT(CARE, X),    K_PLT(SCRL, C),    K_PLT(SLOW, V),    _ B,                _ N,            K_PLT(SLOW, M),    K_PLT(SCRL, U_AMPS),K_PLT(CARE, U_LBKT),_ U_RBKT,
// ╰──────────────────┴──────────────────┼──────────────────┼──────────────────┼───────────────┤   ├───────────────┼──────────────────┼──────────────────┼──────────────────┴──────────────────╯
//                                       │                  │                  │               │   │               │                  │                  │
                                          K_P(&td_mse, _ LGUI),&mt LSHFT SPACE, &mo NAV,            &mo SYM,        &lt CMD BSPC,      K_RH2(&mo ALT, XXX)
//                                       ╰──────────────────┴──────────────────┴───────────────╯   ╰───────────────┴──────────────────┴──────────────────╯
))

/**
 * SYM Layer
 */
ZMK_LAYER(symbol, K_MAPPING(
// ╭──────────────────┬──────────────────┬──────────────────┬──────────────────┬───────────────╮   ╭───────────────┬──────────────────┬──────────────────┬──────────────────┬──────────────────╮
// │                ^ │                @ │                # │                $ │             ( │   │             ) │                ? │                ! │                * │                % │
    _ U_CARET,         _ U_AT,            _ U_HASH,          _ U_DLLR,          _ U_LPAR,           _ U_RPAR,       _ U_QSTM,          _ U_EXCL,          _ U_ASTRK,         _ U_PRCNT,
// ├──────────────────┼──────────────────┼──────────────────┼──────────────────┼───────────────┤   ├───────────────┼──────────────────┼──────────────────┼──────────────────┼──────────────────┤
// │ GUI          ~ Ж │ ALT            ` │ CTRL           ' │ SHIFT          " │             [ │   │             ] │ SHIFT          . │ CTRL           : │ ALT            + │ GUI            = │
    &hml LGUI U_TILDE, &hml LALT U_GRAVE, &hml LCTRL U_SQT,  &hml LSHFT U_DQT,  _ LA(U_LBKT),       _ LA(U_RBKT),   &hmr LSHFT U_DOT,  &hmr LCTRL U_COLON,&hmr LALT U_PLUS,  &hmr LGUI U_EQUAL,
// ├──────────────────┼──────────────────┼──────────────────┼──────────────────┼───────────────┤   ├───────────────┼──────────────────┼──────────────────┼──────────────────┼──────────────────┤
// │               -> │                | │                \ │                / │             { │   │             } │                , │                ; │                - │                _ │
    _ U_ARROW,         _ U_PIPE,          _ U_BSLH,          _ U_FSLH,          _ LA(U_LBRC),      _ LA(U_RBRC),    _ U_COMMA,         _ U_SEMI,          _ U_MINUS,         _ U_UNDER,
// ╰──────────────────┴──────────────────┼──────────────────┼──────────────────┼───────────────┤   ├───────────────┼──────────────────┼──────────────────┼──────────────────┴──────────────────╯
//                                       │                  │                  │               │   │               │                  │                  │
                                          K_P(XXX, _ LGUI),  &mt LSHFT U_NBSP,  &mo NUM,            ___,            K_RH2(_ BSPC, &mo ALT), XXX
//                                       ╰──────────────────┴──────────────────┴───────────────╯   ╰───────────────┴──────────────────┴──────────────────╯
))

/**
 * NAV Layer
 */
ZMK_LAYER(nav, K_MAPPING(
// ╭──────────────────┬──────────────────┬──────────────────┬──────────────────┬───────────────╮   ╭───────────────┬──────────────────┬──────────────────┬──────────────────┬──────────────────╮
    _ U_COMMA,         _ U_N7,            _ U_N8,            _ U_N9,            _ ESC,              _ BSPC,         _ HOME,            _ END,             XXX,               &tog GAM,
// ├──────────────────┼──────────────────┼──────────────────┼──────────────────┼───────────────┤   ├───────────────┼──────────────────┼──────────────────┼──────────────────┼──────────────────┤
    &hml LGUI U_DOT,   &hml LALT U_N4,    &hml LCTRL U_N5,   &hml LSHFT U_N6,   _ TAB,              _ DEL,          &hmr LSHFT LEFT,   &hmr LCTRL DOWN,   &hmr LALT UP,      &hmr LGUI RIGHT,
// ├──────────────────┼──────────────────┼──────────────────┼──────────────────┼───────────────┤   ├───────────────┼──────────────────┼──────────────────┼──────────────────┼──────────────────┤
    _ U_N0,            _ U_N1,            _ U_N2,            _ U_N3,            _ ENTER,            _ ENTER,        _ PG_UP,           _ PG_DN,           _ APOS,            &caps_word,
// ╰──────────────────┴──────────────────┼──────────────────┼──────────────────┼───────────────┤   ├───────────────┼──────────────────┼──────────────────┼──────────────────┴──────────────────╯
//                                       │                  │                  │               │   │               │                  │                  │
                                          K_P(XXX, _ LGUI),  &mt LSHFT SPACE,   ___,                &mo NUM,        _ BSPC,            XXX
//                                       ╰──────────────────┴──────────────────┴───────────────╯   ╰───────────────┴──────────────────┴──────────────────╯
))

/**
 * NUM Layer
 */
ZMK_LAYER(num, K_MAPPING(
// ╭──────────────────┬──────────────────┬──────────────────┬──────────────────┬───────────────╮   ╭───────────────┬──────────────────┬──────────────────┬──────────────────┬──────────────────╮
    _ KP_COMMA,        _ KP_N7,           _ KP_N8,           _ KP_N9,           _ KP_NLCK,          _ F10,          _ F9,              _ F8,              _ F7,              _ F13,
// ├──────────────────┼──────────────────┼──────────────────┼──────────────────┼───────────────┤   ├───────────────┼──────────────────┼──────────────────┼──────────────────┼──────────────────┤
    &hml LGUI KP_DOT,  &hml LALT KP_N4,   &hml LCTRL KP_N5,  &hml LSHFT KP_N6,  XXX,                _ F11,          &hmr LSHFT F6,     &hmr LCTRL F5,     &hmr LALT F4,      &hmr LGUI F14,
// ├──────────────────┼──────────────────┼──────────────────┼──────────────────┼───────────────┤   ├───────────────┼──────────────────┼──────────────────┼──────────────────┼──────────────────┤
    _ KP_N0,           _ KP_N1,           _ KP_N2,           _ KP_N3,           _ KP_ENTER,         _ F12,          _ F3,              _ F2,              _ F1,              _ F15,
// ╰──────────────────┴──────────────────┼──────────────────┼──────────────────┼───────────────┤   ├───────────────┼──────────────────┼──────────────────┼──────────────────┴──────────────────╯
//                                       │                  │                  │               │   │               │                  │                  │
                                          K_P(XXX, _ LGUI),  &mt LSHFT SPACE,   ___,                ___,            _ BSPC,            XXX
//                                       ╰──────────────────┴──────────────────┴───────────────╯   ╰───────────────┴──────────────────┴──────────────────╯
))

/**
 * ALT Layer
 */
ZMK_LAYER(alt, K_MAPPING(
// ╭───────────────┬───────────────┬───────────────┬───────────────┬───────────────╮   ╭───────────────┬───────────────┬───────────────┬───────────────┬───────────────╮
    _ RA(Q),        _ RA(W),        _ RA(E),        _ RA(R),        _ RA(T),            _ RA(Y),        _ RA(U),        _ RA(I),        _ RA(O),        _ RA(P),
// ├───────────────┼───────────────┼───────────────┼───────────────┼───────────────┤   ├───────────────┼───────────────┼───────────────┼───────────────┼───────────────┤
    _ RA(A),        _ RA(S),        _ RA(D),        _ RA(F),        _ RA(G),            _ RA(H),        _ RA(J),        _ RA(K),        _ RA(L),        _ RA(U_TILDE),
// ├───────────────┼───────────────┼───────────────┼───────────────┼───────────────┤   ├───────────────┼───────────────┼───────────────┼───────────────┼───────────────┤
    _ RA(Z),        _ RA(X),        _ RA(C),        _ RA(V),        _ RA(B),            _ RA(N),        _ RA(M),        _ RA(U_AMPS),   _ RA(U_LBKT),   _ RA(U_RBKT),
// ╰───────────────┴───────────────┼───────────────┼───────────────┼───────────────┤   ├───────────────┼───────────────┼───────────────┼───────────────┴───────────────╯
                                    K_P(XXX, _ LGUI),&mt LSHFT U_NBSP, XXX,             K_RH2(XXX, ___), K_RH2(_ BSPC, ___), K_RH2(___, XXX)
//                                 ╰───────────────┴───────────────┴───────────────╯   ╰───────────────┴───────────────┴───────────────╯
))

/**
 * CMD Layer
 */
ZMK_LAYER(cmd, K_MAPPING(
// ╭───────────────┬───────────────┬───────────────┬───────────────┬───────────────╮   ╭───────────────┬───────────────┬───────────────┬───────────────┬───────────────╮
    &bootloader,    &bt BT_SEL 0,   &bt BT_SEL 1,   &bt BT_SEL 2,   &bt BT_CLR,         &out OUT_TOG,   _ C_VOL_DN,     _ C_VOL_UP,     _ C_MUTE,       &bootloader,
// ├───────────────┼───────────────┼───────────────┼───────────────┼───────────────┤   ├───────────────┼───────────────┼───────────────┼───────────────┼───────────────┤
    &sys_reset,     XXX,            _ SPACE_P,      _ SPACE_N,      &tabber,            _ SPACE_U,      _ C_PREV,       _ C_NEXT,       _ C_PP,         &sys_reset,
// ├───────────────┼───────────────┼───────────────┼───────────────┼───────────────┤   ├───────────────┼───────────────┼───────────────┼───────────────┼───────────────┤
    XXX,            &dec_bri,       &inc_bri,       XXX,            &swapper,           _ SPACE_D,      _ C_BRI_DN,     _ C_BRI_UP,     XXX,            &soft_off,
// ╰───────────────┴───────────────┼───────────────┼───────────────┼───────────────┤   ├───────────────┼───────────────┼───────────────┼───────────────┴───────────────╯
                                    _ LGUI,         _ LSHFT,        _ LCTRL,            XXX,            ___,            XXX
//                                 ╰───────────────┴───────────────┴───────────────╯   ╰───────────────┴───────────────┴───────────────╯
))

/**
 * GAM Layer
 */
ZMK_LAYER(game, K_MAPPING(
// ╭───────────────┬───────────────┬───────────────┬───────────────┬───────────────╮   ╭───────────────┬───────────────┬───────────────┬───────────────┬───────────────╮
    _ ESC,          _ Q,            _ W,            _ E,            _ R,                XXX,            _ C_VOL_DN,     _ C_VOL_UP,     _ C_MUTE,       &tog GAM,
// ├───────────────┼───────────────┼───────────────┼───────────────┼───────────────┤   ├───────────────┼───────────────┼───────────────┼───────────────┼───────────────┤
    _ TAB,          _ A,            _ S,            _ D,            _ F,                K_MCLK,         _ LEFT,         _ DOWN,         _ UP,           _ RIGHT,
// ├───────────────┼───────────────┼───────────────┼───────────────┼───────────────┤   ├───────────────┼───────────────┼───────────────┼───────────────┼───────────────┤
    _ LCTRL,        _ Z,            _ X,            _ C,            _ V,                K_LCLK,         K_RCLK,         XXX,            XXX,            XXX,
// ╰───────────────┴───────────────┼───────────────┼───────────────┼───────────────┤   ├───────────────┼───────────────┼───────────────┼───────────────┴───────────────╯
                                    _ LSHFT,        _ SPACE,        &mo GFN,            _ ENTER,        _ BSPC,         _ LALT
//                                 ╰───────────────┴───────────────┴───────────────╯   ╰───────────────┴───────────────┴───────────────╯
))

/**
 * GFN Layer
 */
ZMK_LAYER(gamefn, K_MAPPING(
// ╭───────────────┬───────────────┬───────────────┬───────────────┬───────────────╮   ╭───────────────┬───────────────┬───────────────┬───────────────┬───────────────╮
    _ M,            _ U_N7,         _ U_N8,         _ U_N9,         _ T,                _ Y,            _ U,            _ I,            _ O,            _ P,
// ├───────────────┼───────────────┼───────────────┼───────────────┼───────────────┤   ├───────────────┼───────────────┼───────────────┼───────────────┼───────────────┤
    _ I,            _ U_N4,         _ U_N5,         _ U_N6,         _ G,                _ H,            _ J,            _ K,            _ L,            XXX,
// ├───────────────┼───────────────┼───────────────┼───────────────┼───────────────┤   ├───────────────┼───────────────┼───────────────┼───────────────┼───────────────┤
    _ U_N0,         _ U_N1,         _ U_N2,         _ U_N3,         _ B,                _ N,            _ M,            XXX,            XXX,            XXX,
// ╰───────────────┴───────────────┼───────────────┼───────────────┼───────────────┤   ├───────────────┼───────────────┼───────────────┼───────────────┴───────────────╯
                                    _ LALT,         _ ENTER,        ___,                ___,            ___,            ___
//                                 ╰───────────────┴───────────────┴───────────────╯   ╰───────────────┴───────────────┴───────────────╯
))

#if defined(K_HAS_POINTER)
/**
 * Mouse Layer
 */
ZMK_LAYER(mouse, K_MAPPING(
// ╭───────────────┬───────────────┬───────────────┬───────────────┬───────────────╮   ╭───────────────┬───────────────┬───────────────┬───────────────┬───────────────╮
    XXX,            XXX,            XXX,            XXX,            XXX,                XXX,            XXX,            XXX,            XXX,            XXX,
// ├───────────────┼───────────────┼───────────────┼───────────────┼───────────────┤   ├───────────────┼───────────────┼───────────────┼───────────────┼───────────────┤
    _ LGUI,         &mkp RCLK,      &mkp MCLK,      &mkp LCLK,      &mkp MB5,           XXX,            _ LSHFT,        _ LCTRL,        _ LALT,         _ LGUI,
// ├───────────────┼───────────────┼───────────────┼───────────────┼───────────────┤   ├───────────────┼───────────────┼───────────────┼───────────────┼───────────────┤
    XXX,            &mo CARE,       &mo SCRL,       &mo SLOW,       &mkp MB4,           XXX,            &tog SLOW,      &tog SCRL,      &tog CARE,      XXX,
// ╰───────────────┴───────────────┼───────────────┼───────────────┼───────────────┤   ├───────────────┼───────────────┼───────────────┼───────────────┴───────────────╯
                                    ___,            &mt LSHFT SPACE, XXX,               XXX,            _ BSPC,         XXX
//                                 ╰───────────────┴───────────────┴───────────────╯   ╰───────────────┴───────────────┴───────────────╯
))

/**
 * SLOW Layer
 */
ZMK_LAYER(slow, K_MAPPING(
// ╭───────────────┬───────────────┬───────────────┬───────────────┬───────────────╮   ╭───────────────┬───────────────┬───────────────┬───────────────┬───────────────╮
    XXX,            XXX,            XXX,            XXX,            XXX,                XXX,            XXX,            XXX,            XXX,            XXX,
// ├───────────────┼───────────────┼───────────────┼───────────────┼───────────────┤   ├───────────────┼───────────────┼───────────────┼───────────────┼───────────────┤
    _ LGUI,         &mkp RCLK,      &mkp MCLK,      &mkp LCLK,      &mkp MB5,           XXX,            _ LSHFT,        _ LCTRL,        _ LALT,         _ LGUI,
// ├───────────────┼───────────────┼───────────────┼───────────────┼───────────────┤   ├───────────────┼───────────────┼───────────────┼───────────────┼───────────────┤
    XXX,            XXX,            XXX,            &tog SLOW,      &mkp MB4,           XXX,            &tog SLOW,      XXX,            XXX,            XXX,
// ╰───────────────┴───────────────┼───────────────┼───────────────┼───────────────┤   ├───────────────┼───────────────┼───────────────┼───────────────┴───────────────╯
                                    ___,            &mt LSHFT SPACE, XXX,               XXX,            _ BSPC,         XXX
//                                 ╰───────────────┴───────────────┴───────────────╯   ╰───────────────┴───────────────┴───────────────╯
))

/**
 * SCRL Layer
 */
ZMK_LAYER(scroll, K_MAPPING(
// ╭───────────────┬───────────────┬───────────────┬───────────────┬───────────────╮   ╭───────────────┬───────────────┬───────────────┬───────────────┬───────────────╮
    XXX,            XXX,            XXX,             XXX,           XXX,                XXX,            XXX,            XXX,            XXX,            XXX,
// ├───────────────┼───────────────┼───────────────┼───────────────┼───────────────┤   ├───────────────┼───────────────┼───────────────┼───────────────┼───────────────┤
    _ LGUI,         &mkp RCLK,      &mkp MCLK,       &mkp LCLK,     &mkp MB5,           XXX,            _ LSHFT,        _ LCTRL,        _ LALT,         _ LGUI,
// ├───────────────┼───────────────┼───────────────┼───────────────┼───────────────┤   ├───────────────┼───────────────┼───────────────┼───────────────┼───────────────┤
    XXX,            XXX,            &tog SCRL,      XXX,            &mkp MB4,           XXX,            XXX,            &tog SCRL,      XXX,            XXX,
// ╰───────────────┴───────────────┼───────────────┼───────────────┼───────────────┤   ├───────────────┼───────────────┼───────────────┼───────────────┴───────────────╯
                                    ___,            &mt LSHFT SPACE, XXX,               XXX,            _ BSPC,         XXX
//                                 ╰───────────────┴───────────────┴───────────────╯   ╰───────────────┴───────────────┴───────────────╯
))

/**
 * CARE Layer
 */
ZMK_LAYER(caret, K_MAPPING(
// ╭───────────────┬───────────────┬───────────────┬───────────────┬───────────────╮   ╭───────────────┬───────────────┬───────────────┬───────────────┬───────────────╮
    XXX,            XXX,            XXX,            XXX,            XXX,                XXX,            XXX,            XXX,            XXX,            XXX,
// ├───────────────┼───────────────┼───────────────┼───────────────┼───────────────┤   ├───────────────┼───────────────┼───────────────┼───────────────┼───────────────┤
    _ LGUI,         &mkp RCLK,      &mkp MCLK,      &mkp LCLK,      &mkp MB5,           XXX,            _ LSHFT,        _ LCTRL,        _ LALT,         _ LGUI,
// ├───────────────┼───────────────┼───────────────┼───────────────┼───────────────┤   ├───────────────┼───────────────┼───────────────┼───────────────┼───────────────┤
    XXX,            &tog CARE,      XXX,            XXX,            &mkp MB4,           XXX,            XXX,            XXX,            &tog CARE,      XXX,
// ╰───────────────┴───────────────┼───────────────┼───────────────┼───────────────┤   ├───────────────┼───────────────┼───────────────┼───────────────┴───────────────╯
                                    ___,            &mt LSHFT SPACE, XXX,               XXX,            _ BSPC,         XXX
//                                 ╰───────────────┴───────────────┴───────────────╯   ╰───────────────┴───────────────┴───────────────╯
))
#endif

#undef K_PLT
#undef K_P
#undef K_LCLK
#undef K_RCLK
#undef K_MCLK
#undef K_RH2
