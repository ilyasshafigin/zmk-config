#define MAX_TIMER __UINT32_MAX__ // around 50 days
#define PARAM_1 0
#define PARAM_2 0

#define WELLUM_MACRO(NAME, BINDINGS) ZMK_MACRO(NAME, \
    wait-ms = <0>; \
    tap-ms = <0>; \
    bindings = <BINDINGS>; \
)

#define WELLUM_MACRO_NO_PARAM(NAME, BINDINGS)  WELLUM_MACRO(NAME, BINDINGS)

#define WELLUM_MACRO_ONE_PARAM(NAME, BINDINGS) ZMK_MACRO_ONE_PARAM(NAME, \
    wait-ms = <0>; \
    tap-ms = <0>; \
    bindings = <BINDINGS>; \
)

#define WELLUM_MACRO_TWO_PARAM(NAME, BINDINGS) ZMK_MACRO_TWO_PARAM(NAME, \
    wait-ms = <0>; \
    tap-ms = <0>; \
    bindings = <BINDINGS>; \
)

#define WELLUM_STICKY_FOREVER(name, BIND) ZMK_STICKY_KEY(name, \
    release-after-ms = <MAX_TIMER>; \
    ignore-modifiers; \
    bindings = <BIND>; \
)

#define WELLUM_MODMORPH(NAME, NORMAL, MORPHED, MODS, KEEP_MODS) ZMK_MOD_MORPH(NAME, \
    bindings = <NORMAL>, <MORPHED>; \
    mods = <(MODS)>; \
    keep-mods = <(KEEP_MODS)>; \
)

&sk {
    release-after-ms = <60000>;
};

WELLUM_MACRO_ONE_PARAM(
    m_release_key_twice,
    &macro_release
        &macro_param_1to1 &kp PARAM_1
        &macro_param_1to1 &kp PARAM_1
)

WELLUM_MACRO_ONE_PARAM(
    m_press_key_twice,
    &macro_press
        &macro_param_1to1 &kp PARAM_1
        &macro_param_1to1 &kp PARAM_1
    &macro_pause_for_release
    &macro_tap
        &m_release_key_twice PARAM_1
)


WELLUM_STICKY_FOREVER(sticky_forever, &m_press_key_twice)

WELLUM_MODMORPH(
    cm_gui,
    &sticky_forever LGUI,
    &m_release_key_twice LGUI,
    MOD_LGUI,
    MOD_LGUI
)

WELLUM_MODMORPH(
    cm_alt,
    &sticky_forever LALT,
    &m_release_key_twice LALT,
    MOD_LALT,
    MOD_LALT
)

WELLUM_MODMORPH(
    cm_ctrl,
    &sticky_forever LCTRL,
    &m_release_key_twice LCTRL,
    MOD_LCTL,
    MOD_LCTL
)

WELLUM_MODMORPH(
    cm_sft,
    &sticky_forever LSHIFT,
    &m_release_key_twice LSHIFT,
    MOD_LSFT,
    MOD_LSFT
)

WELLUM_MACRO_TWO_PARAM(
    m_hold_mod_press_key,
    &macro_press
        &macro_param_1to1 &kp PARAM_1
    &macro_tap
        &macro_param_2to1 &kp PARAM_2
)

WELLUM_MODMORPH(
    tabber,
    &m_hold_mod_press_key LCTRL TAB,
    &kp TAB,
    MOD_LCTL,
    MOD_LCTL
)

// WELLUM_MODMORPH(
//     swapper_win,
//     &m_hold_mod_press_key LALT TAB,
//     &kp TAB,
//     MOD_LALT,
//     MOD_LALT
// )

WELLUM_MODMORPH(
    swapper_mac,
    &m_hold_mod_press_key LGUI TAB,
    &kp TAB,
    MOD_LGUI,
    MOD_LGUI
)

WELLUM_MACRO_ONE_PARAM(
    la,
    &macro_tap
        &kp 0 // do nothing, fire all sticky keys
    &macro_press
        &macro_param_1to1 &mo PARAM_1
    &macro_pause_for_release
    &macro_release
        &macro_param_1to1 &mo PARAM_1
        &kp LSHFT
        &kp LCTRL
        &kp LALT
        &kp LGUI
)

ZMK_CONDITIONAL_LAYER(num_layer, NAV SYM, NUM)
