## boards/shields/charybdis/Kconfig.defconfig
```kconfig
if SHIELD_CHARYBDIS_DONGLE || SHIELD_CHARYBDIS_DONGLE_PROSPECTOR

config ZMK_KEYBOARD_NAME
    default "CharybdisDongle"

endif

if SHIELD_CHARYBDIS_CENTRAL_LEFT

config ZMK_KEYBOARD_NAME
    default "Charybdis"

endif


if SHIELD_CHARYBDIS_PERIPHERAL_LEFT || SHIELD_CHARYBDIS_PERIPHERAL_RIGHT

endif
```

## boards/shields/charybdis/Kconfig.shield
```kconfig
config SHIELD_CHARYBDIS_DONGLE
    def_bool $(shields_list_contains,charybdis_dongle)

config SHIELD_CHARYBDIS_CENTRAL_LEFT
    def_bool $(shields_list_contains,charybdis_central_left)

config SHIELD_CHARYBDIS_PERIPHERAL_LEFT
    def_bool $(shields_list_contains,charybdis_peripheral_left)

config SHIELD_CHARYBDIS_PERIPHERAL_RIGHT
    def_bool $(shields_list_contains,charybdis_peripheral_right)
```

## boards/shields/corne/Kconfig.defconfig
```kconfig
if SHIELD_CORNE_DONGLE

config ZMK_KEYBOARD_NAME
    default "CorneDongle"

endif


if SHIELD_CORNE_CENTRAL_LEFT

config ZMK_KEYBOARD_NAME
    default "Corne"

endif


if SHIELD_CORNE_PERIPHERAL_LEFT || SHIELD_CORNE_PERIPHERAL_RIGHT

endif
```

## boards/shields/lapka/Kconfig.shield
```kconfig
config SHIELD_LAPKA_DONGLE
    def_bool $(shields_list_contains,lapka_dongle)

config SHIELD_LAPKA_DONGLE_PROSPECTOR
    def_bool $(shields_list_contains,lapka_dongle_prospector)

config SHIELD_LAPKA_CENTRAL_LEFT
    def_bool $(shields_list_contains,lapka_central_left)

config SHIELD_LAPKA_PERIPHERAL_LEFT
    def_bool $(shields_list_contains,lapka_peripheral_left)

config SHIELD_LAPKA_PERIPHERAL_RIGHT
    def_bool $(shields_list_contains,lapka_peripheral_right)
```

## boards/shields/totem/Kconfig.defconfig
```kconfig
if SHIELD_TOTEM_DONGLE || SHIELD_TOTEM_DONGLE_PROSPECTOR || SHIELD_TOTEM_DONGLE_OLED_32 || SHIELD_TOTEM_DONGLE_OLED_64

config ZMK_KEYBOARD_NAME
    default "TotemDongle"

config ZMK_USB
    default y

config ZMK_SPLIT
    default y

config ZMK_SPLIT_ROLE_CENTRAL
    default y

config ZMK_SPLIT_BLE_CENTRAL_BATTERY_LEVEL_PROXY
    default y

config ZMK_SPLIT_BLE_CENTRAL_BATTERY_LEVEL_FETCHING
    default y

config ZMK_SPLIT_BLE_CENTRAL_PERIPHERALS
    default 2

config BT_MAX_CONN
    default 7

config BT_MAX_PAIRED
    default 7

config ZMK_SLEEP
    default n

endif


if SHIELD_TOTEM_CENTRAL_LEFT

config ZMK_KEYBOARD_NAME
    default "Totem"

config ZMK_SPLIT
    default y

config ZMK_SPLIT_ROLE_CENTRAL
    default y

config ZMK_SLEEP
    default y

endif


if SHIELD_TOTEM_PERIPHERAL_LEFT || SHIELD_TOTEM_PERIPHERAL_RIGHT

config ZMK_SPLIT
    default y

config ZMK_SPLIT_ROLE_CENTRAL
    default n

config ZMK_SLEEP
    default y

endif
```

## boards/shields/totem/Kconfig.shield
```kconfig
config SHIELD_TOTEM_DONGLE
    def_bool $(shields_list_contains,totem_dongle)

config SHIELD_TOTEM_DONGLE_OLED_32
    def_bool $(shields_list_contains,totem_dongle_oled_32)

config SHIELD_TOTEM_DONGLE_OLED_64
    def_bool $(shields_list_contains,totem_dongle_oled_64)

config SHIELD_TOTEM_DONGLE_PROSPECTOR
    def_bool $(shields_list_contains,totem_dongle_prospector)

config SHIELD_TOTEM_CENTRAL_LEFT
    def_bool $(shields_list_contains,totem_central_left)

config SHIELD_TOTEM_PERIPHERAL_LEFT
    def_bool $(shields_list_contains,totem_peripheral_left)

config SHIELD_TOTEM_PERIPHERAL_RIGHT
    def_bool $(shields_list_contains,totem_peripheral_right)
```

## config/west.yml
```yaml
manifest:
  remotes:
  - name: zmkfirmware
    url-base: https://github.com/zmkfirmware
  - name: badjeff
    url-base: https://github.com/badjeff
  - name: caksoylar
    url-base: https://github.com/caksoylar
  - name: carrefinho
    url-base: https://github.com/carrefinho
  - name: englmaxi
    url-base: https://github.com/englmaxi
  - name: janpfischer
    url-base: https://github.com/janpfischer
  - name: kot149
    url-base: https://github.com/kot149
  - name: oleksandrmaslov
    url-base: https://github.com/oleksandrmaslov
  - name: urob
    url-base: https://github.com/urob
  - name: zettaface
    url-base: https://github.com/zettaface
  projects:
  # ZMK
  - name: zmk
    remote: zmkfirmware
    #revision: main
    # for fix error in prospector module: implicit declaration of function 'zmk_endpoints_selected'
    revision: ac7f75b8591d39aaf3b66b9d26f26c9ed921a009
    import: app/west.yml

  # Helper
  - name: zmk-helpers
    remote: urob
    revision: main
    path: modules/zmk/helpers

  # Driver
  - name: zmk-pmw3610-driver
    remote: badjeff
    revision: zmk-0.4
    path: modules/zmk/pmw3610-driver

  # Behavior & Input processor
  - name: zmk-smart-toggle
    remote: caksoylar
    revision: main
    path: modules/zmk/smart-toggle
  - name: zmk-input-processor-keybind
    remote: zettaface
    revision: main
    path: modules/zmk/input-processor-keybind
  - name: zmk-pointing-acceleration
    remote: oleksandrmaslov
    revision: main
    path: modules/zmk/pointing-acceleration
  - name: zmk-scroll-snap
    remote: kot149
    revision: v1
    path: modules/zmk/scroll-snap

  # Dongle
  - name: prospector-zmk-module
    remote: carrefinho
    revision: feat/new-status-screens #main
    path: modules/zmk/prospector
  - name: zmk-dongle-display
    remote: englmaxi
    #revision: main
    # for fix error in prospector module: implicit declaration of function 'zmk_endpoints_selected'
    revision: 9f0f0bf3107ff976e696a01c169fdd076c2874aa
    path: modules/zmk/dongle-display
  # - name: zmk-dongle-screen
    # remote: janpfischer
    # revision: main
    # path: modules/zmk/dongle-screen
  self:
    path: config
```

## dts/bindings/zmk,behavior-battery-percentage-printer.yaml
```yaml
# SPDX-License-Identifier: MIT

description: "Behavior that types the battery percentage."

compatible: "zmk,behavior-battery-percentage-printer"

include: zero_param.yaml

properties:
  digit-keycodes:
    type: array
    required: false
    description: Keycodes used for digits 0 through 9 when typing battery percentage.
  space-keycode:
    type: int
    required: false
    description: Keycode used for the space character.
  dot-keycode:
    type: int
    required: false
    description: Keycode used for the dot character.
  percent-keycode:
    type: int
    required: false
    description: Keycode used for the percent character.
```

## keyboards/boards/shields/charybdis/Kconfig.defconfig
```kconfig
if SHIELD_CHARYBDIS_DONGLE || SHIELD_CHARYBDIS_DONGLE_PROSPECTOR

config ZMK_KEYBOARD_NAME
    default "CharybdisDongle"

config ZMK_USB
    default y

config ZMK_SPLIT
    default y

config ZMK_SPLIT_ROLE_CENTRAL
    default y

config ZMK_SPLIT_BLE_CENTRAL_BATTERY_LEVEL_PROXY
    default y

config ZMK_SPLIT_BLE_CENTRAL_BATTERY_LEVEL_FETCHING
    default y

config ZMK_SPLIT_BLE_CENTRAL_PERIPHERALS
    default 2

config BT_MAX_CONN
    default 7

config BT_MAX_PAIRED
    default 7

config ZMK_SLEEP
    default n

endif


if SHIELD_CHARYBDIS_CENTRAL_RIGHT

config ZMK_KEYBOARD_NAME
    default "Charybdis"

config ZMK_SPLIT
    default y

config ZMK_SPLIT_ROLE_CENTRAL
    default y

config ZMK_SLEEP
    default y

endif


if SHIELD_CHARYBDIS_PERIPHERAL_LEFT || SHIELD_CHARYBDIS_PERIPHERAL_RIGHT

config ZMK_SPLIT
    default y

config ZMK_SPLIT_ROLE_CENTRAL
    default n

config ZMK_SLEEP
    default y

endif


# PMW3610 Driver
if SHIELD_CHARYBDIS_DONGLE || SHIELD_CHARYBDIS_DONGLE_PROSPECTOR || SHIELD_CHARYBDIS_CENTRAL_RIGHT || SHIELD_CHARYBDIS_PERIPHERAL_RIGHT

config SPI
    default y
config INPUT
    default y
config ZMK_MOUSE
    default y
config ZMK_POINTING
    default y
config PMW3610_ALT
    default y
config PMW3610_ALT_SMART_ALGORITHM
    default y
config PMW3610_ALT_REPORT_INTERVAL_MIN
    default 12
config PMW3610_ALT_REST1_SAMPLE_TIME_MS
    default 100
config PMW3610_ALT_REST2_SAMPLE_TIME_MS
    default 200
config PMW3610_ALT_REST3_SAMPLE_TIME_MS
    default 300
config PMW3610_ALT_RUN_DOWNSHIFT_TIME_MS
    default 2000
config PMW3610_ALT_REST1_DOWNSHIFT_TIME_MS
    default 3000
config PMW3610_ALT_REST2_DOWNSHIFT_TIME_MS
    default 30000

endif
```

## keyboards/boards/shields/charybdis/Kconfig.shield
```kconfig
config SHIELD_CHARYBDIS_DONGLE
    def_bool $(shields_list_contains,charybdis_dongle)

config SHIELD_CHARYBDIS_DONGLE_PROSPECTOR
    def_bool $(shields_list_contains,charybdis_dongle_prospector)

config SHIELD_CHARYBDIS_CENTRAL_RIGHT
    def_bool $(shields_list_contains,charybdis_central_right)

config SHIELD_CHARYBDIS_PERIPHERAL_LEFT
    def_bool $(shields_list_contains,charybdis_peripheral_left)

config SHIELD_CHARYBDIS_PERIPHERAL_RIGHT
    def_bool $(shields_list_contains,charybdis_peripheral_right)
```

## keyboards/boards/shields/lapka/Kconfig.defconfig
```kconfig
if SHIELD_LAPKA_DONGLE || SHIELD_LAPKA_DONGLE_PROSPECTOR

config ZMK_KEYBOARD_NAME
    default "LapkaDongle"

config ZMK_USB
    default y

config ZMK_SPLIT
    default y

config ZMK_SPLIT_ROLE_CENTRAL
    default y

config ZMK_SPLIT_BLE_CENTRAL_BATTERY_LEVEL_PROXY
    default y

config ZMK_SPLIT_BLE_CENTRAL_BATTERY_LEVEL_FETCHING
    default y

config ZMK_SPLIT_BLE_CENTRAL_PERIPHERALS
    default 2

config BT_MAX_CONN
    default 7

config BT_MAX_PAIRED
    default 7

config ZMK_SLEEP
    default n

endif


if SHIELD_LAPKA_CENTRAL_LEFT

config ZMK_KEYBOARD_NAME
    default "Lapka"

config ZMK_SPLIT
    default y

config ZMK_SPLIT_ROLE_CENTRAL
    default y

config ZMK_SLEEP
    default y

endif


if SHIELD_LAPKA_PERIPHERAL_LEFT || SHIELD_LAPKA_PERIPHERAL_RIGHT

config ZMK_SPLIT
    default y

config ZMK_SPLIT_ROLE_CENTRAL
    default n

config ZMK_SLEEP
    default y

endif
```

## modules/zmk-trackball-arrows/Kconfig
```kconfig
DT_COMPAT_ZMK_INPUT_PROCESSOR_TRACKBALL_ARROWS := zmk,input-processor-trackball-arrows

config ZMK_INPUT_PROCESSOR_TRACKBALL_ARROWS
    bool
    default $(dt_compat_enabled,$(DT_COMPAT_ZMK_INPUT_PROCESSOR_TRACKBALL_ARROWS))
```

## modules/zmk-trackball-arrows/dts/bindings/input_processors/zmk,input-processor-trackball-arrows.yaml
~~~~yaml
description: |
  Trackball to Arrow Keys Input Processor

  This input processor transforms trackball movements (relative X/Y input events)
  into arrow key presses.

  Example usage in keymap:
  ```
  &trackball_arrows {
      threshold = <5>;
      deadzone-x = <2>;
      deadzone-y = <2>;
  };
  
  &trackball_listener {
      input-processors = <&trackball_arrows>;
  };
  ```

compatible: "zmk,input-processor-trackball-arrows"

include: ip_zero_param.yaml

properties:
  threshold:
    type: int
    default: 5
    description: |
      Minimum movement distance in pixels to trigger arrow key press.
      Smaller values = more sensitive, larger values = less sensitive.
      Recommended range: 3-10 pixels.

  deadzone-x:
    type: int
    default: 2
    description: |
      Horizontal deadzone threshold to filter noise from sensor.
      Movements smaller than this are ignored (in pixels).

  deadzone-y:
    type: int
    default: 2
    description: |
      Vertical deadzone threshold to filter noise from sensor.
      Movements smaller than this are ignored (in pixels).

  bindings:
    type: phandle-array
    required: true
~~~~
