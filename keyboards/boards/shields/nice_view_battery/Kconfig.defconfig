## keyboards/boards/shields/nice_view_battery/Kconfig.defconfig
```kconfig
if SHIELD_NICE_VIEW_BATTERY

config LS0XX_VCOM_THREAD_PRIO
    default 11

config LV_Z_VDB_SIZE
    default 100

config LV_DPI_DEF
    default 161

config LV_Z_BITS_PER_PIXEL
    default 1

choice LV_COLOR_DEPTH
    default LV_COLOR_DEPTH_1
endchoice

choice ZMK_DISPLAY_WORK_QUEUE
    default ZMK_DISPLAY_WORK_QUEUE_DEDICATED
endchoice

choice ZMK_DISPLAY_STATUS_SCREEN
    default ZMK_DISPLAY_STATUS_SCREEN_CUSTOM
endchoice

config LV_Z_MEM_POOL_SIZE
    default 8192 if ZMK_DISPLAY_STATUS_SCREEN_CUSTOM

config ZMK_DISPLAY_STATUS_SCREEN_CUSTOM
    imply NICE_VIEW_BATTERY_WIDGET_STATUS

config NICE_VIEW_BATTERY_WIDGET_STATUS
    bool "Peripheral nice!view battery status widget"
    select LV_USE_LABEL
    select LV_USE_IMAGE
    select LV_USE_CANVAS

config NICE_VIEW_BATTERY_WIDGET_INVERTED
    bool "Invert battery status widget colors"

config NICE_VIEW_BATTERY_PERCENT_ROTATE_180
    bool "Rotate battery percentage 180 degrees in the raw display coordinates"
    default y if SHIELD_TEMPORAL_PERIPHERAL_RIGHT

endif # SHIELD_NICE_VIEW_BATTERY
```

## keyboards/boards/shields/temporal/Kconfig.defconfig
```kconfig
# Copyright (c) 2024 Curtis Bollinger
# SPDX-License-Identifier: MIT
# Adapted from curbol/temporal-zmk revision 306ef1f91f27a7ce5f407be3719d508489bb53da.

if SHIELD_TEMPORAL_DONGLE || SHIELD_TEMPORAL_DONGLE_PROSPECTOR

config ZMK_KEYBOARD_NAME
    default "TemporalDongle"

config ZMK_USB
    default y

config ZMK_SPLIT
    default y

config ZMK_SPLIT_ROLE_CENTRAL
    default y

config ZMK_SPLIT_BLE_CENTRAL_BATTERY_LEVEL_PROXY
    default y

config ZMK_SPLIT_BLE_CENTRAL_BATTERY_LEVEL_FETCHING
    default y

config ZMK_SPLIT_BLE_CENTRAL_PERIPHERALS
    default 2

config BT_MAX_CONN
    default 7

config BT_MAX_PAIRED
    default 7

config ZMK_SLEEP
    default n

endif

if SHIELD_TEMPORAL_CENTRAL_LEFT

config ZMK_KEYBOARD_NAME
    default "Temporal"

config ZMK_SPLIT
    default y

config ZMK_SPLIT_ROLE_CENTRAL
    default y

config ZMK_SLEEP
    default y

endif

if SHIELD_TEMPORAL_PERIPHERAL_LEFT || SHIELD_TEMPORAL_PERIPHERAL_RIGHT

config ZMK_SPLIT
    default y

config ZMK_SPLIT_ROLE_CENTRAL
    default n

config ZMK_SLEEP
    default y

endif
```

## keyboards/boards/shields/temporal/Kconfig.shield
```kconfig
config SHIELD_TEMPORAL_DONGLE
    def_bool $(shields_list_contains,temporal_dongle)

config SHIELD_TEMPORAL_DONGLE_PROSPECTOR
    def_bool $(shields_list_contains,temporal_dongle_prospector)

config SHIELD_TEMPORAL_CENTRAL_LEFT
    def_bool $(shields_list_contains,temporal_central_left)

config SHIELD_TEMPORAL_PERIPHERAL_LEFT
    def_bool $(shields_list_contains,temporal_peripheral_left)

config SHIELD_TEMPORAL_PERIPHERAL_RIGHT
    def_bool $(shields_list_contains,temporal_peripheral_right)
```

## keyboards/boards/shields/temporal_nice_view/Kconfig.shield
```kconfig
config SHIELD_TEMPORAL_NICE_VIEW
    def_bool $(shields_list_contains,temporal_nice_view)
```
