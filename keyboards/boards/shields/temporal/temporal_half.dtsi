#include "temporal.dtsi"

&kscan0 {
    compatible = "zmk,kscan-gpio-matrix";
    diode-direction = "col2row";
    row-gpios
        = <&pro_micro 4 (GPIO_ACTIVE_HIGH | GPIO_PULL_DOWN)> // row_top
        , <&pro_micro 5 (GPIO_ACTIVE_HIGH | GPIO_PULL_DOWN)> // row_home
        , <&pro_micro 6 (GPIO_ACTIVE_HIGH | GPIO_PULL_DOWN)> // row_bottom
        , <&pro_micro 7 (GPIO_ACTIVE_HIGH | GPIO_PULL_DOWN)> // row_thumb
        ;
};
