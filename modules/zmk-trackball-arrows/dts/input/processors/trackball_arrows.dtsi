#include <dt-bindings/input/input-event-codes.h>
#include <dt-bindings/zmk/keys.h>

/ {
    trackball_arrows: trackball_arrows {
        compatible = "zmk,input-processor-trackball-arrows";
        #input-processor-cells = <0>;
        
        threshold = <20>;
        deadzone-x = <1>;
        deadzone-y = <1>;

        bindings = <&kp LEFT &kp RIGHT &kp UP &kp DOWN>;
    };
};
